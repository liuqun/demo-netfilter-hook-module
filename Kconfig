## Kconfig
```kconfig
config NFTEST
	tristate "IP: My Netfilter test module"
	depends on NET && INET
	depends on IPV6 || !IPV6
	default m
	help
	  My netfilter test module
```

## liuquntest/Kconfig
```kconfig
config LIUQUNTEST
	tristate "IP: LIUQUN Netfilter test module"
	depends on NET && INET
	depends on IPV6 || !IPV6
	default m
	help
	  LIUQUN netfilter test module
```
